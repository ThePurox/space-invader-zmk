## boards/shields/space_invader/Kconfig.defconfig
```kconfig
if SHIELD_SPACE_INVADER_LEFT

# Name must be less than 16 characters long!
config ZMK_KEYBOARD_NAME
    default "Space Invader"

config ZMK_SPLIT_ROLE_CENTRAL
    default y

endif

if SHIELD_SPACE_INVADER_LEFT || SHIELD_SPACE_INVADER_RIGHT

config ZMK_SPLIT
    default y

endif
```

## boards/shields/space_invader/Kconfig.shield
```kconfig
# No whitespace after the comma or in your part name!
config SHIELD_SPACE_INVADER_LEFT
    def_bool $(shields_list_contains,space_invader_left)

# No whitespace after the comma or in your part name!
config SHIELD_SPACE_INVADER_RIGHT
    def_bool $(shields_list_contains,space_invader_right)
```
